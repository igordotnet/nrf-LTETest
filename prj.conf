## CMakeLists.txt
```
cmake_minimum_required(VERSION 3.20.0)
find_package(Zephyr REQUIRED HINTS $ENV{ZEPHYR_BASE})

project(nrf-lteTest)

# TODO: Remove this when the modem firmware is included in the Zephyr SDK
# This is a workaround to ensure the modem firmware is available for the application.
# Force inclusion of modem firmware binary
# set(NRF_MODEM_FW_FILE ${CMAKE_CURRENT_SOURCE_DIR}/nrf_modem.bin)
# message(STATUS "Using modem firmware from: ${NRF_MODEM_FW_FILE}")

target_sources(app PRIVATE src/main.c)
```

## prj.conf
```kconfig
# Secuity & Memory Protection

CONFIG_ARM_MPU=y
CONFIG_HW_STACK_PROTECTION=y
CONFIG_ARM_TRUSTZONE_M=y
CONFIG_TRUSTED_EXECUTION_NONSECURE=y

# Console & UART

CONFIG_SERIAL=y
CONFIG_CONSOLE=y
CONFIG_UART_CONSOLE=y
CONFIG_UART_INTERRUPT_DRIVEN=y

# Logging & Debugging

CONFIG_LOG=y
CONFIG_LOG_PRINTK=y
CONFIG_LOG_MODE_DEFERRED=y
CONFIG_LOG_RUNTIME_FILTERING=y
CONFIG_LOG_DEFAULT_LEVEL=4
CONFIG_LOG_BUFFER_SIZE=2048
CONFIG_LOG_PROCESS_TRIGGER_THRESHOLD=0
CONFIG_DEBUG=y
CONFIG_DEBUG_OPTIMIZATIONS=y

# More debugging options

CONFIG_MODEM_INFO=y
CONFIG_USE_SEGGER_RTT=y
CONFIG_RTT_CONSOLE=y
CONFIG_LOG_BACKEND_RTT=y
CONFIG_AT_HOST_LIBRARY=y

# System

CONFIG_ASSERT=y
CONFIG_REBOOT=y

# Networking

CONFIG_NETWORKING=y
CONFIG_NET_IPV4=y
CONFIG_NET_NATIVE=n 
CONFIG_NET_SOCKETS=y
CONFIG_NET_SOCKETS_OFFLOAD=y

# TLS/SSL

CONFIG_MBEDTLS=y

# LTE & Modem

CONFIG_LTE_LINK_CONTROL=y
CONFIG_LTE_NETWORK_MODE_LTE_M=y
CONFIG_LTE_LC_PSM_MODULE=y
CONFIG_LTE_LC_EDRX_MODULE=y
CONFIG_LTE_LC_TAU_PRE_WARNING_MODULE=y
CONFIG_NRF_MODEM_LIB=y
CONFIG_MODEM_KEY_MGMT=y
CONFIG_MODEM_INFO=y

# MQTT & AWS IoT

CONFIG_MQTT_KEEPALIVE=1200
CONFIG_MQTT_HELPER=y
CONFIG_MQTT_HELPER_SEC_TAG=12345
CONFIG_AWS_IOT=y
CONFIG_AWS_IOT_CLIENT_ID_STATIC="renewit-dev-sjomac"
CONFIG_AWS_IOT_BROKER_HOST_NAME="a2362yg19xu4v5-ats.iot.us-east-1.amazonaws.com"

# Date/Time

CONFIG_DATE_TIME=y

# AT Host

CONFIG_AT_HOST_LIBRARY=y
```

## boards/nRF9160dk_nrf9160ns.overlay
```dts
&uart0 {
    status = "okay";
    current-speed = <115200>;
    // used for AT Host and logging
};
```

## src/main.c
```c
/* Included Libraries */
#include <zephyr/kernel.h>
#include <zephyr/device.h>
#include <zephyr/sys/util.h>
#include <zephyr/sys/printk.h>
#include <zephyr/logging/log.h>

#include <modem/nrf_modem_lib.h>
#include <modem/lte_lc.h>
#include <modem/modem_info.h>
#include <modem/modem_key_mgmt.h>
// #include <modem/at_cmd.h>

#include <nrf_socket.h>
#include <stdio.h>
#include <inttypes.h>

#include <hal/nrf_gpio.h>

#define MODEM_POWER_PIN  12

LOG_MODULE_REGISTER(main, LOG_LEVEL_INF);

static struct k_sem lte_connected = Z_SEM_INITIALIZER(lte_connected, 0, 1);
static struct k_work reconnect_work;

static bool connection_stable = false;

/* Function Declarations */
void modem_power_on(void);
void configure_lte_mode(void);
static void lte_handler(const struct lte_lc_evt *const evt);

/* Modem Power Control */
void modem_power_on(void) 
{
    LOG_INF("Powering on modem...");
    nrf_gpio_cfg_output(MODEM_POWER_PIN);
    nrf_gpio_pin_set(MODEM_POWER_PIN);
    k_sleep(K_SECONDS(2));
    LOG_INF("Modem power stabilized");
}

/* LTE Mode Configuration */
void configure_lte_mode(void)
{
    int err;

    LOG_INF("Configuring LTE mode...");

    // Try LTE-M first
    err = lte_lc_system_mode_set(LTE_LC_SYSTEM_MODE_LTEM, LTE_LC_SYSTEM_MODE_PREFER_AUTO);
    if (err) {
        LOG_WRN("Failed to set LTE-M mode: %d", err);
    }

    k_sleep(K_SECONDS(1));
}

/* Enhanced LTE Event Handler */
static void lte_handler(const struct lte_lc_evt *const evt)
{
    LOG_INF("LTE Event: Type %d", evt->type);

    switch (evt->type) {
    case LTE_LC_EVT_NW_REG_STATUS:
        LOG_INF("LTE Event: NW_REG_STATUS - Status: %d", evt->nw_reg_status);

        switch(evt->nw_reg_status) {
        case LTE_LC_NW_REG_REGISTERED_HOME:
        case LTE_LC_NW_REG_REGISTERED_ROAMING:
            LOG_INF("LTE connected successfully");
            connection_stable = true;
            k_sem_give(&lte_connected);
            break;

        case LTE_LC_NW_REG_NOT_REGISTERED:
            LOG_WRN("Not registered - will attempt reconnection");
            if (connection_stable) {
                k_work_submit(&reconnect_work);
            }
            break;

        case LTE_LC_NW_REG_REGISTRATION_DENIED:
            LOG_ERR("Registration denied - check SIM/APN/Network");
            break;

        case LTE_LC_NW_REG_SEARCHING:
            LOG_INF("Searching for network...");
            break;

        default:
            LOG_INF("Registration status: %d", evt->nw_reg_status);
            break;
        }
        break;

    case LTE_LC_EVT_PSM_UPDATE:
        LOG_INF("LTE Event: PSM_UPDATE - TAU: %d, Active Time: %d",
                evt->psm_cfg.tau, evt->psm_cfg.active_time);
        break;

    case LTE_LC_EVT_EDRX_UPDATE:
        LOG_INF("LTE Event: EDRX_UPDATE - eDRX: %f, PTW: %f",
                (double)evt->edrx_cfg.edrx, (double)evt->edrx_cfg.ptw);
        break;

    case LTE_LC_EVT_RRC_UPDATE:
        LOG_INF("LTE Event: RRC_UPDATE - RRC Mode: %s",
                evt->rrc_mode == LTE_LC_RRC_MODE_CONNECTED ? "Connected" : "Idle");
        break;

    case LTE_LC_EVT_CELL_UPDATE:
        LOG_INF("LTE Event: CELL_UPDATE - Cell ID: %d, TAC: %d",
                evt->cell.id, evt->cell.tac);
        break;

    case LTE_LC_EVT_LTE_MODE_UPDATE:
        LOG_INF("LTE Event: LTE_MODE_UPDATE - LTE Mode: %d", evt->lte_mode);
        break;

    case LTE_LC_EVT_TAU_PRE_WARNING:
        LOG_INF("LTE Event: TAU_PRE_WARNING");
        break;

    default:
        LOG_WRN("LTE Event: Unknown event type: %d", evt->type);
        break;
    }
}

/* Main Function */
int main(void)
{
    int err = 0;
    char uuid[64] = {0};

    LOG_INF("=== Starting nRF9160 LTE Test Application ===");
    LOG_INF("nRF Connect SDK v3.0.2");


    LOG_INF("Delaying startup for modem power stabilization...");
    k_sleep(K_SECONDS(5));

    // Power on modem (if needed)
    // modem_power_on();

    LOG_INF("Initializing modem library...");
    err = nrf_modem_lib_init();
    if (err < 0) {
        LOG_ERR("Modem library initialization failed: %d", err);
        return 1;
    }

    // Additional delay for modem initialization
    k_sleep(K_SECONDS(3));

    // Initialize modem info
    LOG_INF("Initializing modem info...");
    err = modem_info_init();
    if (err) {
        LOG_ERR("Modem info initialization failed: %d", err);
        return 1;
    }

    // Wait longer before getting UUID
    k_sleep(K_SECONDS(2));

    err = modem_info_get_fw_uuid(uuid, sizeof(uuid));
    if (err) {
        LOG_ERR("Failed to get modem UUID: %d", err);
        return 1;
    }
    LOG_INF("Modem UUID: %s", uuid);

    // Configure LTE mode before checking modem status
    configure_lte_mode();

    // Wait after mode setting
    k_sleep(K_SECONDS(2));

    LOG_INF("Attempting LTE connection...");
    err = lte_lc_connect_async(lte_handler);
    if (err) {
        LOG_ERR("lte_lc_connect_async failed: %d", err);
        return 1;
    }

    LOG_INF("Waiting for LTE connection...");

    // Add timeout for connection attempt
    if (k_sem_take(&lte_connected, K_SECONDS(120)) != 0) {
        LOG_ERR("LTE connection timeout after 120 seconds");
        return 1;
    }

    LOG_INF("LTE connection established successfully!");

    LOG_INF("=== LTE Connection Test Complete ===");
    LOG_INF("Device is now connected to the cellular network");

    // Main loop - keep connection alive and monitor status
    int loop_count = 0;
    while (1) {
        k_sleep(K_SECONDS(30));
        loop_count++;

        LOG_INF("Status check #%d - Connection stable: %s", 
                loop_count, connection_stable ? "YES" : "NO");

        // Periodic signal quality check
        if (loop_count % 10 == 0) {  // Every 5 minutes
            int rsrp = 0;
            if (modem_info_short_get(MODEM_INFO_RSRP, &rsrp) == 0) {
                LOG_INF("Current RSRP: %d dBm", rsrp - 140);
            }
        }
    }

    return 0;
}
```
